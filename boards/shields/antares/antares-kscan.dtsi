/ {
	default_kscan: kscan {
		compatible = "zmk,kscan-gpio-direct";
		wakeup-source;

		input-gpios
			//left side of controller board
			// = <&gpio0 6  (GPIO_ACTIVE_LOW | GPIO_PULL_UP)>// D1   P0.06  // encoder A
			// , <&gpio0 8  (GPIO_ACTIVE_LOW | GPIO_PULL_UP)>// D0   P0.08  // encoder B
			= <&gpio0 17 (GPIO_ACTIVE_LOW | GPIO_PULL_UP)>// D2   P0.17
			, <&gpio0 20 (GPIO_ACTIVE_LOW | GPIO_PULL_UP)>// D3   P0.20
			, <&gpio0 22 (GPIO_ACTIVE_LOW | GPIO_PULL_UP)>// D4   P0.22
			, <&gpio0 24 (GPIO_ACTIVE_LOW | GPIO_PULL_UP)>// D5   P0.24
			, <&gpio1 0  (GPIO_ACTIVE_LOW | GPIO_PULL_UP)>// D6   P1.00
			, <&gpio0 11 (GPIO_ACTIVE_LOW | GPIO_PULL_UP)>// D7   P0.11
			, <&gpio1 4  (GPIO_ACTIVE_LOW | GPIO_PULL_UP)>// D8   P1.04
			, <&gpio1 6  (GPIO_ACTIVE_LOW | GPIO_PULL_UP)>// D9   P1.06

			//right side of controller board
			, <&gpio0 31 (GPIO_ACTIVE_LOW | GPIO_PULL_UP)>// D21  P0.31
			, <&gpio0 29 (GPIO_ACTIVE_LOW | GPIO_PULL_UP)>// D20  P0.29
			, <&gpio0 2  (GPIO_ACTIVE_LOW | GPIO_PULL_UP)>// D19  P0.02
			, <&gpio1 15 (GPIO_ACTIVE_LOW | GPIO_PULL_UP)>// D18  P1.15
			, <&gpio1 13 (GPIO_ACTIVE_LOW | GPIO_PULL_UP)>// D15  P1.13
			, <&gpio1 11 (GPIO_ACTIVE_LOW | GPIO_PULL_UP)>// D14  P1.11
			, <&gpio0 10 (GPIO_ACTIVE_LOW | GPIO_PULL_UP)>// D16  P0.10
			, <&gpio0 9  (GPIO_ACTIVE_LOW | GPIO_PULL_UP)>// D10  P0.09

			//additional pins in center
			, <&gpio1 1  (GPIO_ACTIVE_LOW | GPIO_PULL_UP)>//      P1.01
			, <&gpio1 2  (GPIO_ACTIVE_LOW | GPIO_PULL_UP)>//      P1.02
			// , <&gpio1 7  (GPIO_ACTIVE_LOW | GPIO_PULL_UP)>//      P1.07   // not used
			;
	};
};
