#include <dt-bindings/zmk/matrix_transform.h>
#include "antares-transform.dtsi"
#include "antares-kscan.dtsi"
#include "antares-encoders.dtsi"

/ {
	chosen {
		zmk,matrix_transform = &default_transform;
	};
};
