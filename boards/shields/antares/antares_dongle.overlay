#include <dt-bindings/zmk/matrix_transform.h>
#include "antares-transform.dtsi"

/ {
	chosen {
		zmk,matrix_transform = &default_transform;
		zmk,kscan = &mock_kscan;
	};

	mock_kscan: mock_kscan_0 {
		compatible = "zmk,kscan-mock";
		columns = <0>;
		rows = <0>;
		events = <0>;
	};
};
